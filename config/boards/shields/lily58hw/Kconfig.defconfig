## config/boards/shields/lily58hw/Kconfig.defconfig
```kconfig
if SHIELD_LILY58HW_LEFT

config ZMK_KEYBOARD_NAME
    default "Lily58"

config ZMK_SPLIT_ROLE_CENTRAL
    default y

endif

if SHIELD_LILY58HW_LEFT || SHIELD_LILY58HW_RIGHT

config ZMK_SPLIT
    default y

endif
```

## config/boards/shields/lily58hw/Kconfig.shield
```kconfig
config SHIELD_LILY58HW_LEFT
    def_bool $(shields_list_contains,lily58hw_left)

config SHIELD_LILY58HW_RIGHT
    def_bool $(shields_list_contains,lily58hw_right)
```
