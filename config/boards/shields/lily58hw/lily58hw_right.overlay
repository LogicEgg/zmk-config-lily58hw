#include "lily58hw.dtsi"

&default_transform {
    col-offset = <6>;
};

&kscan0 {
    col-gpios
        = <&gpio0 9  GPIO_ACTIVE_HIGH>   /* col 0 Y H N  + inner key */
        , <&gpio0 10 GPIO_ACTIVE_HIGH>   /* col 1 U J M  + inner (tilted) thumb */
        , <&gpio1 11 GPIO_ACTIVE_HIGH>   /* col 2 I K ,  + thumb */
        , <&gpio1 13 GPIO_ACTIVE_HIGH>   /* col 3 O L .  + thumb */
        , <&gpio1 15 GPIO_ACTIVE_HIGH>   /* col 4 P ; /  + outer thumb */
        , <&gpio0 2  GPIO_ACTIVE_HIGH>   /* col 5 outer (Bksp/Enter) */
        ;
};
